## arch/arm/mach-imx/imx8m/Kconfig
```kconfig
if ARCH_IMX8M

config IMX8M
	bool
	select ROM_UNIFIED_SECTIONS

config IMX8MQ
	bool
	select IMX8M

config IMX8MM
	bool
	select IMX8M

config SYS_SOC
	default "imx8m"

choice
	prompt  "NXP i.MX8M board select"
	optional

config TARGET_IMX8MQ_EVK
	bool "imx8mq_evk"
	select IMX8MQ
	select IMX8M_LPDDR4

config TARGET_IMX8MM_EVK
	bool "imx8mm LPDDR4 EVK board"
	select IMX8MM
	select SUPPORT_SPL
	select IMX8M_LPDDR4

config TARGET_KONTRON_N8000
	bool "Kontron Electronics N8000"
	select IMX8MM
	select SUPPORT_SPL
	select IMX8M_LPDDR4

endchoice

source "board/freescale/imx8mq_evk/Kconfig"
source "board/freescale/imx8mm_evk/Kconfig"
source "board/kontron/imx/mx8mm/Kconfig"

endif
```

## board/kontron/imx/mx6ul/Kconfig
```kconfig
if TARGET_KONTRON_N631X

config SYS_BOARD
	string
	default "imx/mx6ul"

config SYS_VENDOR
	string
	default "kontron"

config SYS_CONFIG_NAME
	string
	default "kontron_n631x"

endif
```

## board/kontron/imx/mx8mm/Kconfig
```kconfig
if TARGET_KONTRON_N8000

config SYS_BOARD
	string
	default "imx/mx8mm"

config SYS_VENDOR
	string
	default "kontron"

config SYS_CONFIG_NAME
	string
	default "kontron_n8000"

config KONTRON_ENV_FDT_FILE
	string
	default "imxceet-ul-2-s.dtb"

config KONTRON_ENV_KERNEL_ADDR
	string
	default "0x41000000"

config KONTRON_ENV_FDT_ADDR
	string
	default "0x43000000"

config KONTRON_ENV_PXE_ADDR
	string
	default "0x43100000"

config KONTRON_ENV_RAMDISK_ADDR
	string
	default "0x43200000"

endif
```
